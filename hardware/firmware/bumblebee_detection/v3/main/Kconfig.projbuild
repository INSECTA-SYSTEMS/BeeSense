## hardware/firmware/bumblebee_detection/v3/main/Kconfig.projbuild
```kconfig
menu "BeeSense WiFi Configuration"

    config WIFI_SSID
        string "WiFi SSID"
        default "BeeSense_AP"
        help
            SSID (Netzwerkname) des WiFi Access Points.

    config WIFI_PASSWORD
        string "WiFi Password"
        default "beesense123"
        help
            Passwort für den WiFi Access Point.

    config WIFI_MAXIMUM_RETRY
        int "Maximum retry"
        default 5
        help
            Maximale Anzahl an Verbindungsversuchen bevor aufgegeben wird.

    config DASHBOARD_HOST
        string "Dashboard Server Host"
        default "3.75.94.127"
        help
            IP-Adresse oder Hostname des Dashboard-Servers.

    config DASHBOARD_PORT
        int "Dashboard Server Port"
        default 8080
        help
            Port des Dashboard-Servers für die HTTP API.

    config WIFI_SEND_INTERVAL_MS
        int "WiFi Send Interval (ms)"
        default 10000
        help
            Intervall in Millisekunden für das Senden der Tracking-Daten ans Dashboard.
            Standard: 10000ms (10 Sekunden)

endmenu
```

## hardware/firmware/bumblebee_detection/v3/main/bumblebee_detect/Kconfig
```kconfig
menu "models: bumblebee_detect"
    config FLASH_ESPDET_PICO_224_224_BUMBLEBEE
        bool "flash espdet_pico_224_224_bumblebee"
        depends on !BUMBLEBEE_DETECT_MODEL_IN_SDCARD
        default y

    config DEFAULT_BUMBLEBEE_DETECT_MODEL
        int
        default 0


    choice
        prompt "model location"
        default BUMBLEBEE_DETECT_MODEL_IN_FLASH_RODATA
        help
            bumblebee_detect model location
        config BUMBLEBEE_DETECT_MODEL_IN_FLASH_RODATA
            bool "flash_rodata"
        config BUMBLEBEE_DETECT_MODEL_IN_FLASH_PARTITION
            bool "flash_partition"
        config BUMBLEBEE_DETECT_MODEL_IN_SDCARD
            bool "sdcard"
    endchoice


    config BUMBLEBEE_DETECT_MODEL_LOCATION
        int
        default 0 if BUMBLEBEE_DETECT_MODEL_IN_FLASH_RODATA
        default 1 if BUMBLEBEE_DETECT_MODEL_IN_FLASH_PARTITION
        default 2 if BUMBLEBEE_DETECT_MODEL_IN_SDCARD

    config BUMBLEBEE_DETECT_MODEL_SDCARD_DIR
        string "bumblebee_detect model sdcard dir"
        default "" if IDF_TARGET_ESP32S3
        default "" if IDF_TARGET_ESP32P4
        depends on BUMBLEBEE_DETECT_MODEL_IN_SDCARD
        help
            Directory of models relative to sdcard mount point.
endmenu
```
